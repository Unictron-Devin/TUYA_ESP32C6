## sdkconfig.defaults
```kconfig
# Chip Selection
CONFIG_IDF_TARGET="esp32c6"

# ESP-NimBLE configuration
CONFIG_BT_ENABLED=y
CONFIG_BT_BLUEDROID_ENABLED=n
CONFIG_BT_NIMBLE_ENABLED=y
CONFIG_BT_NIMBLE_MAX_CONNECTIONS=1
CONFIG_BT_NIMBLE_ATT_PREFERRED_MTU=247

# Partition scheme with factory, two OTA slots and dedicated Tuya NVS.
CONFIG_PARTITION_TABLE_CUSTOM=y
CONFIG_PARTITION_TABLE_CUSTOM_FILENAME="partitions.csv"
CONFIG_PARTITION_TABLE_FILENAME="partitions.csv"

# Flash settings for ESP32-C6 2MB module
CONFIG_ESPTOOLPY_FLASHSIZE_2MB=y
CONFIG_ESPTOOLPY_FLASHSIZE="2MB"
CONFIG_ESPTOOLPY_FLASHFREQ_80M=y

# Logging
CONFIG_LOG_DEFAULT_LEVEL=3
```
